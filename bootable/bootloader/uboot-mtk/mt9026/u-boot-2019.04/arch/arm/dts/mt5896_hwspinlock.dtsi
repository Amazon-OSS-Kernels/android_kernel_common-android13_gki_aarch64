// SPDX-License-Identifier: (GPL-2.0 OR BSD-3-Clause)
/*
 * Copyright (c) 2023 MediaTek Inc.
 */

/ {
	hwlock: hwspinlock@1c604000 {
		#address-cells = <2>;
		#size-cells = <2>;
		compatible = "mediatek,mt5896-hwspinlock";
		reg = <0x0 0x1c604000 0x0 0x40>;
		#hwlock-cells = <1>;
	};
};
