// SPDX-License-Identifier: (GPL-2.0 OR BSD-3-Clause)
/*
 * Copyright (c) 2020 MediaTek Inc.
 */

/ {
	gpu: gpu0@1c5e0000{
	};

	mtk_gpu_sensor: mtk_gpu_sensor {
		compatible = "gpu-thermal";
		reg = <0 0x1C021000 0 0x1000>,
		<0 0x1C04A000 0 0x1000>,
		<0 0x1C020000 0 0x1000>;
		io-channels = <&saradc 13>;
		io-channel-names = "gpu_adc";
	};
};
