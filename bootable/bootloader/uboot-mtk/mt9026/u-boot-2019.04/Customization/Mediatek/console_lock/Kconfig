## bootable/bootloader/uboot-mtk/t61p/u-boot-2019.04/Mediatek-internal/drivers/driver/Kconfig
```kconfig
#
# GPIO infrastructure and drivers
#

menu "Mediatek Driver Support"

config API_GFX
    bool "Enable GFX option"
    default y
    help
      Enable compilation option for API GFX.

config GFX_TRAPZOID
    bool "Enable GFX TRAPZOID"
    default y
    help
      Select if you want to enable GFX TRAPZOID. If unsure, say 'N'.

config API_GOP
    bool "Enable API_GOP option"
    default y
    help
      Enable compilation option for API GOP.

config GOP_POOL_ARRANGE
    bool "Enable GOP POOL ARRANGE"
    default y
    help
      Select if you want to enable GOP POOL ARRANGE. If unsure, say 'N'.

config GOP_GWIN_MISC
    bool "Enable GOP GWIN MISC"
    default y
    help
      Select if you want to enable GOP GWIN MISC. If unsure, say 'N'.

config GOP_2ND_PAL
    bool "Enable GOP 2ND PAL"
    default y
    help
      Select if you want to enable GOP 2ND Palette. If unsure, say 'N'.

config GOP_BG
    bool "Enable GOP background"
    default y
    help
      Select if you want to enable GOP Back Ground. If unsure, say 'N'.

config GOP_FADE
    bool "Enable GOP FADE"
    default y
    help
      Select if you want to enable GOP FADE. If unsure, say 'N'.

config GOP_YUV_SWAP
    bool "Enable GOP YUV SWAP"
    default y
    help
      Select if you want to enable GOP YUV SWAP. If unsure, say 'N'.

config GOP_CONTRAST
    bool "Enable GOP CONTRAST"
    default y
    help
      Select if you want to enable GOP CONTRAST. If unsure, say 'N'.

config GOP_VE_CAPTURE
    bool "Enable GOP VE CAPTURE"
    default y
    help
      Select if you want to enable GOP VE CAPTURE. If unsure, say 'N'.

config GOP_SCROLL
    bool "Enable GOP SCROLL"
    default y
    help
      Select if you want to enable GOP SCROLL. If unsure, say 'N'.

config GOP_TEST_PATTERN
    bool "Enable GOP TEST PATTERN"
    default y
    help
      Select if you want to enable GOP TEST PATTERN. If unsure, say 'N'.

config GOP_AFBC_FEATURE
    bool "Enable GOP AFBC FEATURE"
    default y
    help
      Select if you want to enable GOP AFBC feature. If unsure, say 'N'.

config GOP_CSC_MATRIX
    bool "Enable GOP CSC MATRIX"
    default y
    help
      Select if you want to enable GOP programable 3*3 matrix. If unsure, say 'N'.

config GOP_DST_OP_DUAL_RATE
    bool "Enable dst op dual rate"
    default y
    help
      Select if you want to enable GOP OP DUAL RATE. If unsure, say 'N'.

config GOP_DST_FRC
    bool "Enable dst frc"
    default y
    help
      Select if you want to enable GOP FRC. If unsure, say 'N'.

config GOP_SCALING_DOWN
    bool "Enable GOP scaling down"
    default y
    help
      Select if you want to enable GOP scaling down. If unsure, say 'N'.

config GOP_DEBUG_LEVEL
    bool "Enable GOP debug level"
    default y
    help
      Select if you want to enable GOP debug level. If unsure, say 'N'.

config MBOOT
    bool "Enable MBOOT option"
    help
      Enable compilation option for MBOOT.

config ENABLE_DEMURA
    bool "Demura Support"
    default n
    help
        Enable DeMura Function

config ENABLE_EEPROM
    bool "Eeprom Support"
    default n
    help
        Enable Eeprom Function.

if(ENABLE_DEMURA)
    config DEMURA_SPI_BUS
    string "SPI Bus for Demura Read"
    default "1:0"
    help
        Fill the spi for demura function

    config DEMURA_BIN_PARTITION
    string "Partition for Demura Bin"
    default "persist"
    help
        Fill the partition for demura bin

    config DEMURA_BIN_PATH
    string "Path for Demura Bin"
    default "/demura_out.bin"
    help
        Fill the path for demura bin

    config DEMURA_BIN_PATH_DLG
    string "Path for Demura_DLG Bin"
    default "/demura_out2.bin"
    help
        Fill the path for demura_DLG bin

    config DEMURA_FCIC
    bool "DEMURA_FCIC"
    default n
    help
        Selecting this item will enable FCIC-Demura-IP

    config DEMURA_SIW
    bool "DEMURA_SIW"
    default n
    help
        Selecting this item will enable LXS(SIW)-Demura-IP

    config DEMURA_MSTAR
    bool "DEMURA_MTK"
    default y
    help
        Selecting this item will enable Mstar-Demura-IP

if(DEMURA_MSTAR)
config ENABLE_DEMURA_DLG
    bool "Demura DLG Support"
    default y
    help
        Enable DeMura DLG Function

choice
    prompt "Select Demura Vendor"
    default DEMURA_VENDOR_MSTAR

    config DEMURA_VENDOR_MSTAR
    bool "DEMURA_VENDOR_MSTAR"
    help
        Selecting this item will enable Mstar-Demura

    config DEMURA_VENDOR_CSOT
    bool "DEMURA_VENDOR_CSOT"
    help
        Selecting this item will enable CSOT-Demura

    config DEMURA_VENDOR_AUO
    bool "DEMURA_VENDOR_AUO"
    help
        Selecting this item will enable AUO-Demura

    config DEMURA_VENDOR_INNOLUX
    bool "DEMURA_VENDOR_INNOLUX"
    help
        Selecting this item will enable Innolux-Demura

    config DEMURA_VENDOR_LGD
    bool "DEMURA_VENDOR_LGD"
    help
        Selecting this item will enable LGDisplay-Demura

    config DEMURA_VENDOR_CHOT
    bool "DEMURA_VENDOR_CHOT"
    help
        Selecting this item will enable CHOT-Demura

    config DEMURA_VENDOR_NOVA
    bool "DEMURA_VENDOR_NOVA"
    help
        Selecting this item will enable NOVA-Demura

    config DEMURA_VENDOR_SDC
    bool "DEMURA_VENDOR_SDC"
    help
        Selecting this item will enable SDC-Demura

    config DEMURA_VENDOR_CSOT_HISILICON
    bool "DEMURA_VENDOR_CSOT_HISILICON"
    help
        Selecting this item will enable CSOT_HISILICON-Demura

    config DEMURA_VENDOR_MULTI
    bool "DEMURA_VENDOR_MULTI"
    help
        Selecting this item will enable MULTI-Demura
endchoice

if(DEMURA_VENDOR_MULTI)
choice
    prompt "Select Panel Vendor"
    default PANEL_VENDOR_MTK_FORMAT

    config PANEL_VENDOR_AUO
    bool "PANEL_VENDOR_AUO"
    help
        Selecting this item will enable AUO panel type for Demura

    config PANEL_VENDOR_LGD_V18
    bool "PANEL_VENDOR_LGD_V18"
    help
        Selecting this item will enable LGD V18

    config PANEL_VENDOR_LGD_SQ18_19_MONO
    bool "PANEL_VENDOR_LGD_SQ18_19_MONO"
    help
        Selecting this item will enable LGD SQ V18 V19 MONO

    config PANEL_VENDOR_LGD_SQ18_19_COLOR
    bool "PANEL_VENDOR_LGD_SQ18_19_COLOR"
    help
        Selecting this item will enable LGD SQ V18 V19 COLOR

    config PANEL_VENDOR_LGD_V19_MONO
    bool "PANEL_VENDOR_LGD_V19_MONO"
    help
        Selecting this item will enable LGD V19 MONO

    config PANEL_VENDOR_LGD_V19_COLOR
    bool "PANEL_VENDOR_LGD_V19_COLOR"
    help
        Selecting this item will enable LGD V19 COLOR

    config PANEL_VENDOR_NOVA
    bool "PANEL_VENDOR_NOVA"
    help
        Selecting this item will enable NOVA

    config PANEL_VENDOR_CSOT_HISILICON
    bool "PANEL_VENDOR_CSOT_HISILICON"
    help
        Selecting this item will enable CSOT HISILICON

    config PANEL_VENDOR_CSOT_HIMAX
    bool "PANEL_VENDOR_COST_HIMAX"
    help
        Selecting this item will enable CSOT HIMAX

    config PANEL_VENDOR_SDC
    bool "PANEL_VENDOR_SDC"
    help
        Selecting this item will enable SDC

    config PANEL_VENDOR_INX
    bool "PANEL_VENDOR_INX"
    help
        Selecting this item will enable Innolux

    config PANEL_VENDOR_CSOT_CSOT
    bool "PANEL_VENDOR_CSOT_CSOT"
    help
        Selecting this item will enable CSOT_CSOT

    config PANEL_VENDOR_HKC_NOVA
    bool "PANEL_VENDOR_HKC_NOVA"
    help
        Selecting this item will enable HKC

    config PANEL_VENDOR_MTK_FORMAT
    bool "PANEL_VENDOR_MTK_FORMAT"
    help
        Selecting this item will enable MTK format-Demura
endchoice


choice
    prompt "Select Bin Format"
    default MTK_DEMURA_UFC_BIN

    config MTK_DEMURA_DMC_BIN
    bool "MTK_DEMURA_DMC_BIN"
    help
        Selecting this item will enable dmc bin

    config MTK_DEMURA_UFC_BIN
    bool "MTK_DEMURA_UFC_BIN"
    help
        Selecting this item will enable ufc bin
endchoice


if(DEMURA_VENDOR_LGD)
choice
    prompt "Select LGD version"
    config DEMURA_VENDOR_LGD_V19
        bool "DEMURA_VENDOR_LGD_V19"
        help
            Selecting this item will enable V19 LGDisplay-Demura

    config DEMURA_VENDOR_LGD_SQ18_19
        bool "DEMURA_VENDOR_LGD_SQ18_19"
        help
            Selecting this item will enable SQ18_19 LGDisplay-Demura

    config DEMURA_VENDOR_LGD_V18
        bool "DEMURA_VENDOR_LGD_V18"
        help
            Selecting this item will enable V18 LGDisplay-Demura
endchoice

if(DEMURA_VENDOR_LGD_V19 || DEMURA_VENDOR_LGD_SQ18_19)
choice
    prompt "Select Demura CIC or CUC"
    config DEMURA_VENDOR_LGD_CIC_ONLY
        bool "DEMURA_VENDOR_LGD_CIC_ONLY"
        help
            Selecting this item will enable CIC_ONLY LGDisplay-Demura

    config DEMURA_VENDOR_LGD_CIC_CUC
        bool "DEMURA_VENDOR_LGD_CIC_CUC"
        help
            Selecting this item will enable CIC_CUC LGDisplay-Demura
endchoice

endif
endif
endif
endif
endif
endmenu
```

## bootable/bootloader/uboot-mtk/t61p/u-boot-2019.04/Mediatek-internal/impl/ab/Kconfig
```kconfig
#
# GPIO infrastructure and common function
#

menu "Mediatek AB Support"

config AB_SIDELOAD
	bool "Enable AB Sideload"
	depends on ANDROID_AB
	default n
	help
	  Enable AB Sideload feature.

config AB_FROM_ROM
	bool "Enable AB from ROM"
	depends on AB_SIDELOAD
	default n
	help
	  Enable AB selection from ROM feature.

config AB_FIXED_SLOT
	int "Use Fixed Slot"
	depends on !AB_FROM_ROM
	default 0
	help
	  Set fixed slot number if AB_FROM_ROM is not set.

endmenu
```

## bootable/bootloader/uboot-mtk/t61p/u-boot-2019.04/Mediatek-internal/impl/romtblo/Kconfig
```kconfig
#
# GPIO infrastructure and common function
#

menu "Mediatek ROM Table Overlay Support"

config ROM_OVERLAY
	bool "Enable ROM Overlay Support"
	default n
	help
	  Enable ROM overlay function.

config ROM_TABLE_ADDRESS
	hex "Setting ROM table address in DRAM"
	default 0x20000000
	help
	  Setting ROM table address in DRAM

config ROM_OVERLAY_UBOOT
	bool "Enable ROM Overlay at U-BOOT dtb"
	default n
	help
	  Enable ROM overlay at u-boot dtb.

config ROM_OVERLAY_KERNEL
	bool "Enable ROM Overlay at Kernel dtb"
	default n
	help
	  Enable ROM overlay at Kernel dtb.

endmenu
```

## bootable/bootloader/uboot-mtk/t61p/u-boot-2019.04/arch/arm/mach-mediatek/Kconfig
```kconfig
if ARCH_MEDIATEK

config SYS_SOC
	default "mediatek"

config SYS_VENDOR
	default "mediatek"

choice
	prompt "MediaTek board select"

config TARGET_MT7623
	bool "MediaTek MT7623 SoC"
	select CPU_V7A
	select ARCH_MISC_INIT
	help
	  The MediaTek MT7623 is a ARM-based SoC with a quad-core Cortex-A7
	  including NEON and GPU, Mali-450 graphics, several DDR3 options,
	  crypto engine, built-in Wi-Fi / Bluetooth combo chip, JPEG decoder,
	  video interfaces supporting HDMI and MIPI, and video codec support.
	  Peripherals include Gigabit Ethernet, switch, USB3.0 and OTG, PCIe,
	  I2S, PCM, S/PDIF, UART, SPI, I2C, IR TX/RX, and PWM.

config TARGET_MT7629
	bool "MediaTek MT7629 SoC"
	select CPU_V7A
	select SPL
	select ARCH_MISC_INIT
	help
	  The MediaTek MT7629 is a ARM-based SoC with a dual-core Cortex-A7
	  including DDR3, crypto engine, 3x3 11n/ac Wi-Fi, Gigabit Ethernet,
	  switch, USB3.0, PCIe, UART, SPI, I2C and PWM.

config TARGET_MT5888
	bool "MediaTek MT5888 SoC"
	select CPU_V7A
	help
	  The MediaTek M7322 is a ARM-based SoC

config TARGET_MT5896
	bool "MediaTek MT5896 SoC"
	select CPU_V7A
	help
	  The MediaTek MT5896 is a ARM-based SoC

endchoice

config MULTICORES_PLATFORM
	bool "Multi core architecture"
	depends on ARM64
	default n
	help
	  Enable multi core architecture on u-boot. It changes command base mode
	  to task thread mode.

config SMP_BOOT_TIMEOUT_RESET
	bool "SMP boot timeout reset"
	depends on MULTICORES_PLATFORM
	default n
	help
	  Select this option will enable smp timeout reset when bootup.

source "board/mediatek/mt7623/Kconfig"
source "board/mediatek/mt7629/Kconfig"
source "board/mediatek/mt5888/Kconfig"

endif
```

## bootable/bootloader/uboot-mtk/t61p/u-boot-2019.04/board/mediatek/mt5888/Kconfig
```kconfig
if TARGET_MT5888

config SYS_BOARD
	default "mt5888"

config SYS_CONFIG_NAME
	default "mt5888"

menu "Memory setting"

config MIU0_BUSADDR
	hex "Setting MIU0 bus address"
	default 0x20000000
	help
	  Setting MIU0 buss address

config MIU1_BUSADDR
	hex "Setting MIU1 bus address"
	default 0xA0000000
	help
	  Setting MIU1 buss address

config DRAM_SIZE_MB_RELOCATE
	hex "Setting DRAM relocate size (MB)"
	default 152
	help
	  Setting DRAM relocate size (MB)

config ARMv8_64BIT_KERNEL
	bool "Select platform kernel type"
	default y
	help
	  Select platform kernel type

endmenu		# Memory setting
endif
```

## bootable/bootloader/uboot-mtk/t61p/u-boot-2019.04/drivers/hwspinlock/Kconfig
```kconfig
menu "Hardware Spinlock Support"

config DM_HWSPINLOCK
	bool "Enable U-Boot hardware spinlock support"
	help
	  This option enables U-Boot hardware spinlock support

config HWSPINLOCK_SANDBOX
	bool "Enable Hardware Spinlock support for Sandbox"
	depends on SANDBOX && DM_HWSPINLOCK
	help
	  Enable hardware spinlock support in Sandbox. This is a dummy device that
	  can be probed and support all the methods of HWSPINLOCK, but does not
	  really do anything.

config HWSPINLOCK_STM32
	bool "Enable Hardware Spinlock support for STM32"
	depends on ARCH_STM32MP && DM_HWSPINLOCK
	help
	  Enable hardware spinlock support in STM32MP. Hardware spinlocks are
	  hardware mutex which provide a synchronisation mechanism for the
	  various processors on the SoC.

config HWSPINLOCK_MT5896
	bool "Mediatek MT5896 Hardware Spinlock device"
	depends on DM_HWSPINLOCK
	help
	  Say y here to support the Mediatek MT5896 Hardware Spinlock device, which
	  provides a synchronisation mechanism for the various processor on the
	  SoC.

endmenu
```

## bootable/bootloader/uboot-mtk/t61p/u-boot-2019.04/drivers/image/Kconfig
```kconfig
#
# Image decoder
#

menu "Image decoder drivers"

config MTK_NJPD
	bool "MediaTek New JPEG Decoder Driver"
	help
		This Driver support MediaTek New JPEG Decoder Protect
		 Say Y to enable for the MediaTek new JPEG decoder protect.

endmenu
```
