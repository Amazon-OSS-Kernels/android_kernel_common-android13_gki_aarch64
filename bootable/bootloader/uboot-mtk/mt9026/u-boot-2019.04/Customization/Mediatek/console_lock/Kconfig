## bootable/bootloader/uboot-mtk/t61p/u-boot-2019.04/drivers/remoteproc/Kconfig
```kconfig
# SPDX-License-Identifier: GPL-2.0+
#
# (C) Copyright 2015
# Texas Instruments Incorporated - http://www.ti.com/
#

menu "Remote Processor drivers"

# REMOTEPROC gets selected by drivers as needed
# All users should depend on DM
config REMOTEPROC
	bool
	depends on DM

# Please keep the configuration alphabetically sorted.
config K3_SYSTEM_CONTROLLER
	bool "Support for TI' K3 System Controller"
	select REMOTEPROC
	depends on DM
	depends on ARCH_K3
	depends on OF_CONTROL
	help
	  Say 'y' here to add support for TI' K3 System Controller.

config REMOTEPROC_MTK_PMU_CORTEX_M4
	bool "Support for MTK PMU remoteproc driver for CORTEX_M4"
	select REMOTEPROC
	depends on DM
	depends on ARM
	depends on OF_CONTROL
	help
	  Say 'y' here to add support for MTK PMU remoteproc driver for CORTEX_M4.

config REMOTEPROC_MTK_VAD_CORTEX_M4
	bool "Support for MTK VAD remoteproc driver for CORTEX_M4"
	select REMOTEPROC
	depends on DM
	depends on ARM
	depends on OF_CONTROL
	help
	  Say 'y' here to add support for MTK VAD remoteproc driver for CORTEX_M4.

config REMOTEPROC_MTK_VAD_CORTEX_M4_STANDBY
	bool "Support for MTK VAD remoteproc driver for CORTEX_M4 in standby"
	select REMOTEPROC
	depends on DM
	depends on ARM
	depends on OF_CONTROL
	depends on REMOTEPROC_MTK_VAD_CORTEX_M4
	default y
	help
	  Say 'y' here to add support for MTK VAD remoteproc driver for CORTEX_M4
	  in standby mode.

config REMOTEPROC_MTK_PMU_MCS_51
	bool "Support for MTK PMU remoteproc driver for MCS_51"
	select REMOTEPROC
	depends on DM
	depends on ARM
	depends on OF_CONTROL
	help
	  Say 'y' here to add support for MTK PMU remoteproc driver for MCS_51.

config REMOTEPROC_MTK_PQU
	bool "Support for MTK PQU remoteproc driver"
	select REMOTEPROC
	depends on DM
	depends on ARM
	depends on OF_CONTROL
	help
	  Say 'y' here to add support for MTK PQU remoteproc driver.

config REMOTEPROC_K3
	bool "Support for TI's K3 based remoteproc driver"
	select REMOTEPROC
	depends on DM
	depends on ARCH_K3
	depends on OF_CONTROL
	help
	  Say 'y' here to add support for TI' K3 remoteproc driver.

config REMOTEPROC_SANDBOX
	bool "Support for Test processor for Sandbox"
	select REMOTEPROC
	depends on DM
	depends on SANDBOX
	help
	  Say 'y' here to add support for test processor which does dummy
	  operations for sandbox platform.

config REMOTEPROC_TI_POWER
	bool "Support for TI Power processor"
	select REMOTEPROC
	depends on DM
	depends on ARCH_KEYSTONE
	depends on OF_CONTROL
	help
	  Say 'y' here to add support for TI power processors such as those
	  found on certain TI keystone and OMAP generation SoCs.
endmenu
```
