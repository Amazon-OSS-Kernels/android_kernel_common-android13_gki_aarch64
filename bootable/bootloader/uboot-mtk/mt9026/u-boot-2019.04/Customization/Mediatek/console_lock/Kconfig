## bootable/bootloader/uboot-mtk/mt9026/u-boot-2019.04/Customization/Mediatek/console_lock/Kconfig
```kconfig
#
# Console lock configuration
#

menu "Mediatek Console Lock Support"

config CONSOLE_LOCK
	bool "Enable Console Lock feature"
	depends on MMC_MTK_DTV
	default n
	help
	  Enable console lock / log enable feature.
	  To enable / disable uart output by config log enable bit.
	  To enable / disable log enable bit configurable by console lock

config CONSOLE_UNLOCK_USB
	bool "Enable Console Unlock Usb feature"
	depends on MMC_MTK_DTV
	default n
	help
	  Enable console unlock usb feature.
	  To enable / disable unlock console by using response file in usb.

endmenu
```

## bootable/bootloader/uboot-mtk/mt9026/u-boot-2019.04/Customization/Mediatek/standby/Kconfig
```kconfig
#
# Standby configuration
#

menu "Mediatek Standby Support"

config MTK_BT_USB
	bool "Enable MTK BT feature"
	default y
	help
	  Enable MTK BT feature.
	  To enable / disable MTK BT in secondary standby

config RTK_BT_USB
	bool "Enable RTK BT feature"
	default n
	help
	  Enable RTK BT feature.
	  To enable / disable RTK BT in secondary standby

endmenu
```

## bootable/bootloader/uboot-mtk/mt9026/u-boot-2019.04/Mediatek-internal/Kconfig
```kconfig
# Mediatek-internal
menu "Mediatek"

config VERSION_NUMBER
	string "Uboot Version Number for Anti-Rollback "
	default 0
	help
	  Set Uboot version number for Anti-Rollback.

config HAPS
	bool "Target platform is HAPS"
	default n
	help
	  Enabling this option will disable feature in development
	  when target platform is HAPS.

config ROLLBACK_INDEX_IN_EFUSE
    bool "Enable EFuse read"
    default n
    depends on OPTEE
    help
        Enable EFuse read Function

menu "DTB Overlay"

config DTB_OVERLAY_FOR_UBOOT_DTB
	bool "Do dtb overlay for u-boot dtb"
	default n
	help
	  Enabling this option will do dtb overlay for u-boot dtb by default.

config DTB_OVERLAY_FOR_KERNEL_DTB
	bool "Do dtb overlay for kernel dtb"
	default n
	help
	  Enabling this option will do dtb overlay for kernel dtb by default.

config MULTIPLE_DTB_SELECTION
	bool "Enable dtb selection for multiple dtb"
	default n
	help
	  Enabling this option will do dtb selection for multiple dtb in dtbo partition by default.

config AMZ_ODMTVCONFIG_DTBO_OVERLAY
	bool "Enable AMZ second dtbo overlay from odmtvconfig partition"
	default n
	help
	  Enabling this option will overlay dtbo from odmtvconfig partition

endmenu

    choice
        prompt "Select RSA padding mode"
        default RSA_EMSA_PSS
        config RSA_PKCS1_V1_5
            bool "RSA PKCS1 v1.5"
        config RSA_EMSA_PSS
            bool "RSA EMSA PSS"
    endchoice

menu "IR Support"

config BOOT_IR
	bool "Enable boot ir"
	default n
	help
	  Enabling this option will enable select boot mode via IR.
endmenu

menu "eMMC Self Adaption"

config USERDATA_PARTITION_SELF_ADAPTION
	bool "Enable userdata partition self-adaption"
	default n
	help
	  Enabling this option will enable userdata partition self-adaption.
	  userdata partition must be the last emmc partition.

config SAMESIZE_EMMC_SELF_ADAPTION
	bool "Skip same size emmc userdata partition self-adaption"
	depends on USERDATA_PARTITION_SELF_ADAPTION
	default n
	help
	  Enabling this option will skip same size emmc userdata partition self-adaption.
	  userdata partition must be the last emmc partition.

endmenu

config DATA_SEPARATION
	bool "Enable data separation feature"
	default n
	help
	  Enabling this option will enable data separation feature.
	  the project_id.ini and dataIndex_*.ini will be used.

config BOOT_LOGO
	bool "Enable boot logo feature"
	default n
	help
	  Enabling this option will enable bootlogo feature.
	  the project_id.ini, dataIndex_*.ini, and bootlogo.ini will be used.

config DIAG_TRANSITION_DIALOG
	bool "Enable diag to FOS transition display feature"
	default n
	help
	  Enabling this option will enable the dedicated screen
	  showing the green "OK" or red "UL" screens at the end of
	  diag to FOS mode transition.

config ENABLE_QHB
    bool "QHB Support"
    default n
    help
      Enabling this option will enable QHB feature.
      Eeprom  must be supported.

source "Mediatek-internal/drivers/Kconfig"
source "Mediatek-internal/impl/Kconfig"

config ENABLE_CUST_IC_UPDATE
	bool "Enable cust ic update"
	default n
	help
	  Enable cust ic update.

endmenu		# Mediatek
```

## bootable/bootloader/uboot-mtk/mt9026/u-boot-2019.04/Mediatek-internal/impl/Kconfig
```kconfig
# Mediatek Implement

source "Mediatek-internal/impl/ab/Kconfig"
source "Mediatek-internal/impl/upgrade/Kconfig"
source "Mediatek-internal/impl/romtblo/Kconfig"
source "Mediatek-internal/impl/jpd/Kconfig"
source "Mediatek-internal/impl/pm/Kconfig"
source "Mediatek-internal/impl/pmu/Kconfig"
source "Mediatek-internal/impl/standby/Kconfig"
source "Mediatek-internal/impl/led/Kconfig"
```

## bootable/bootloader/uboot-mtk/mt9026/u-boot-2019.04/Mediatek-internal/impl/jpd/Kconfig
```kconfig
#
# GPIO infrastructure and common function
#

menu "Mediatek JPEG Decoder Support"

config JPEG_DECODER
	bool "Enable JPEG decoder"
	default n
	help
	  Enable JPEG decoder feature.

endmenu
```

## bootable/bootloader/uboot-mtk/mt9026/u-boot-2019.04/Mediatek-internal/impl/led/Kconfig
```kconfig
#
# infrastructure and common function
#

menu "Mediatek LED Setting"

config MTK_LED_SETTING
	bool "Enable LED Setting"
	default n
	help
	  Enabling this option will enable LED setting.

config MTK_LED_IN_STANDBY
	bool "Enable LED Setting in Bootloader Standby"
	default n
	help
	  Enabling this option will enable the LED setting
	  when entering the bootloader standby.

endmenu
```

## bootable/bootloader/uboot-mtk/mt9026/u-boot-2019.04/Mediatek-internal/impl/pm/Kconfig
```kconfig
#
# infrastructure and common function
#

menu "Mediatek PM Support"

config MTK_PM
	tristate "MediaTek PM Support"
	help
	  Say yes here to add support for Mediatek PM driver.
	  MTK_PM is a physical H/W which consists PWR_CTL and dummy register.
	  The driver does provide boot reason, wakeup reason and wakeup config.

endmenu
```

## bootable/bootloader/uboot-mtk/mt9026/u-boot-2019.04/Mediatek-internal/impl/pmu/Kconfig
```kconfig
#
# infrastructure and common function
#

menu "Mediatek PMU Support"

config MTK_PMU
	tristate "MediaTek PMU Support"
	help
	  Say yes here to add support for Mediatek PMU loader.

config BOOTPMU_EARLY
	bool "Enable boot pmu early"
	default n
	help
	  Enabling this option will enable do boot pmu early.

endmenu
```

## bootable/bootloader/uboot-mtk/mt9026/u-boot-2019.04/Mediatek-internal/impl/standby/Kconfig
```kconfig
#
# infrastructure and common function
#

menu "Mediatek Second Standby Mode Support"

config SECOND_STANDBY
	bool "Enable Second Standby Mode"
	default n
	help
	  Enable Second Standby Mode.

endmenu
```

## bootable/bootloader/uboot-mtk/mt9026/u-boot-2019.04/Mediatek-internal/impl/upgrade/Kconfig
```kconfig
#
# GPIO infrastructure and common function
#

menu "Mediatek Upgrade Support"

config MTK_UPGRADE
    bool "Enable MTK Upgrade"
    default y
    help
      Enable MTK upgrade implement.
      (including USB, OAD, NET upgrade)

config USB_UPGRADE
    bool "Enable USB Upgrade"
    depends on MTK_UPGRADE
    default y
    help
      Enable USB upgrade function.

config MTK_INTERNAL_USB_UPGRADE_SCRIPPT
    bool "Enable MTK Internel USB Upgrade Script"
    depends on MTK_UPGRADE
    default n
    help
      Enable MTK Internel USB Upgrade Script.	  

config OAD_UPGRADE
    bool "Enable OAD and Updatelogic Upgrade"
    depends on MTK_UPGRADE
    default y
    help
      Enable OAD/Updatelogic upgrade function.

config UPGRADE_OSD
    bool "Enable Upgrade OSD"
    depends on USB_UPGRADE
    help
      Enable upgrade OSD(On Screen Display).
      The screen will show the progress of the current update.
      If unsure, say 'N'.

config LVGL_UPGRADE_BAR
    bool "LVGL_UPGRADE_BAR"
    depends on UPGRADE_OSD
    help
      Use libLVGL paint upgrade bar.

config SECURE_UPGRADE_V2
    bool "Enable Secure Upgrade V2"
    depends on USB_UPGRADE
    help
      Enable secure upgrade version 2.
      If unsure, say 'N'.

config SECURE_AES256_SHA384
    bool "Use AES256 and SHA384"
    depends on SECURE_UPGRADE_V2
    default y
    help
      Use AES256/SHA384 to decrypt and hash upgrade.bin .

config SECURE_HW_IP
    bool "Use HW Driver"
    depends on SECURE_UPGRADE_V2
    help
      Use HW drivers AES, RSA, SHA to replace SW solution .

config USB_AUTO_UPGRADE
    bool "Enable USB Auto Upgrade"
    depends on USB_UPGRADE
    help
      Enable USB auto-upgrade when AC and DC on.
      If unsure, say 'N'.

config USB_UPGRADE_LED
    bool "Enable LED state for USB Upgrade"
    default n
    help
      Enable LED state when USB upgrade is started.

endmenu
```

## bootable/bootloader/uboot-mtk/mt9026/u-boot-2019.04/amazon/Kconfig
```kconfig
#
# Copyright (c) 2023 Amazon.com, Inc. or its affiliates.  All rights reserved.
#

# Amazon-internal
menu "Amazon"

config UFBL
	bool "Enable Amazon UFBL"
	default n
	help
	  Enable Amazon UFBL Feature
endmenu	#Amazon
```

## bootable/bootloader/uboot-mtk/mt9026/u-boot-2019.04/board/mediatek/mt5896/Kconfig
```kconfig
if TARGET_MT5896

config SYS_BOARD
	default "mt5896"

config SYS_CONFIG_NAME
	default "mt5896"

menu "Memory setting"

config BUSADDR_START
	hex "Setting bus address start"
	default 0x20000000
	help
	  Setting buss address

config BUSADDR_SIZE
	hex "Setting bus address size"
	default 0x200000000
	help
	  Setting buss address size

config DRAM_SIZE_MB_RELOCATE
	hex "Setting DRAM relocate size (MB)"
	default 152
	help
	  Setting DRAM relocate size (MB)

config ARMv8_64BIT_KERNEL
	bool "Select platform kernel type"
	default y
	help
	  Select platform kernel type

endmenu		# Memory setting
endif
```

## bootable/bootloader/uboot-mtk/mt9026/u-boot-2019.04/drivers/ufs/Kconfig
```kconfig
config UFS
	bool "Support UFS controllers"
	select HAVE_BLOCK_DEVICE
	help
	  This enables support for UFS (Universal Flash Storage),
	  a serial interface widely used with storage peripherals.
	  The core driver is derived from linux 5.4.19. 

config DM_UFS
	bool "Support UFS controllers with driver model"
	depends on BLK
	help
	  This option enables the UFS (Universal Flash Storage) uclass.
	  For every device configuration (LUNs) a block device is created
	  with RAW read/write and filesystem support.

config UFS_DEBUG
	bool "Support UFS DEBUG"
	depends on UFS
	help
	  This option enables the UFS (Universal Flash Storage) debug.

config SUPPORT_UFS_RPMB
	bool "Support UFS replay protected memory block (RPMB)"
	imply CMD_UFS_RPMB
	help
	  Enable support for reading, writing and programming the
	  key for the Replay Protection Memory Block partition in UFS.

config UFS_MTK_DTV
	bool "Mediatek specific hooks to UFS controller platform driver"
	depends on UFS && DM_UFS
	help
	  This selects the Mediatek specific additions to UFSHCD platform driver.
	  UFS host on Mediatek needs some vendor specific configuration before
	  accessing the hardware which includes PHY configuration and vendor
	  specific registers.

	  Select this if you have UFS controller on Mediatek chipset.

	  If unsure, say N.
```

## bootable/bootloader/uboot-mtk/t61p/u-boot-2019.04/Customization/Mediatek/standby/Kconfig
```kconfig
#
# Standby configuration
#

menu "Mediatek Standby Support"

config MTK_BT_USB
	bool "Enable BT feature"
	default y
	help
	  Enable BT feature.
	  To enable / disable BT in secondary standby

endmenu
```
